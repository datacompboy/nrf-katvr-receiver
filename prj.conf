## CMakeLists.txt
```
cmake_minimum_required(VERSION 3.20.0)
find_package(Zephyr REQUIRED HINTS $ENV{ZEPHYR_BASE})

project(nrf-katvr-receiver)

target_sources(app PRIVATE src/main.c)

target_sources(app PRIVATE src/kat_ble.c)
target_sources(app PRIVATE src/kat_ble_pack.c)

target_sources(app PRIVATE src/kat_usb.c)
target_sources(app PRIVATE src/kat_usb_pack.c)
target_sources(app PRIVATE src/kat_usb_serialno.c)
```

## Kconfig
```
source "Kconfig.zephyr"

# Project-specific settings

config APP_DEBUG
    bool "Should we build application in debug mode (with extra logging, tracking and usb-serial console)"
    default n

config APP_WAIT_FOR_OBSERVER
    bool "If yes, application will wait for terminal connection to console before start"
    default y
    depends on APP_DEBUG

config APP_PACKET_LOG
    bool "Should we spam all packets captured to the log or not"
    default n

config APP_ACCEPT_UNPAIRED_SENSORS
    bool "Should we keep reading sensors that wasn't 'paired' by gateway or not"
    default n

config APP_KEEP_CONNECTIONS
    bool "Should we keep connection from the sensors for extra minute, or disconnect immediately as gateway ask for."
    default n

config APP_DEBUG_BOOT_CONNECTIONS
    bool "Should we connect at the device boot time or wait until gateway ask for it."
    default APP_KEEP_CONNECTIONS

config APP_FEET_ROTATION
    bool "Support rotation for the feet sensors to a configured angle"
    default y

choice
    prompt "Frequency of KAT Sensors refreshment"
    default APP_KAT_FREQ_PARAM

config APP_KAT_FREQ_PARAM
    bool "Use configurable refresh rate 50..133 Hz"

config APP_KAT_FREQ_133
    bool "Use 133Hz refresh rate (unstable)"

config APP_KAT_FREQ_114
    bool "Use 114Hz refresh rate (unstable)"

config APP_KAT_FREQ_100
    bool "Use 100Hz refresh rate"

config APP_KAT_FREQ_86
    bool "Use ~86Hz refresh rate (like standard receiver)"

config APP_KAT_FREQ_80
    bool "Use 80Hz refresh rate"

config APP_KAT_FREQ_67
    bool "Use 67Hz refresh rate"

config APP_KAT_FREQ_57
    bool "Use 57Hz refresh rate"

config APP_KAT_FREQ_50
    bool "Use 50Hz refresh rate"

endchoice

# The connection interval defines maximum refresh speed per sensor,
# with at least 2 intervals required for each sensor to update.
config APP_KAT_CONN_INTERVAL
    int
    default 9 if APP_KAT_FREQ_PARAM  # default param == default receiver
    default 6 if APP_KAT_FREQ_133
    default 7 if APP_KAT_FREQ_114
    default 8 if APP_KAT_FREQ_100
    default 9 if APP_KAT_FREQ_86
    default 10 if APP_KAT_FREQ_80
    default 12 if APP_KAT_FREQ_67
    default 14 if APP_KAT_FREQ_57
    default 16 if APP_KAT_FREQ_50

# Overrides for deafults to manage debugging with single APP_DEBUG
config LOG
    default APP_DEBUG
    depends on APP_DEBUG
config LOG_PRINTK
    default APP_DEBUG
    depends on APP_DEBUG
config LOG_MODE_IMMEDIATE
    depends on APP_DEBUG
config SERIAL
    default APP_DEBUG
    depends on APP_DEBUG
config CONSOLE
    bool
    default APP_DEBUG
    depends on APP_DEBUG
config UART_CONSOLE
    default APP_DEBUG
    depends on APP_DEBUG
config UART_LINE_CTRL
    default APP_DEBUG
    depends on APP_DEBUG
config USB_CDC_ACM
    default APP_DEBUG
    depends on APP_DEBUG
config USB_DEVICE_INITIALIZE_AT_BOOT
    default n
    depends on APP_DEBUG
```

## prj.conf
```kconfig
# Enable bare minimum of BT stack to establish a connection.
CONFIG_BT=y
CONFIG_BT_CENTRAL=y

CONFIG_BT_GATT_CLIENT=n
CONFIG_BT_GATT_DM=n
CONFIG_BT_SMP=n

# No scan needed, we connect to fixed (defined by gateway)
CONFIG_BT_SCAN=n
CONFIG_BT_FILTER_ACCEPT_LIST=y

# Enable up to 3 connections (dir/left/right)
CONFIG_BT_MAX_CONN=3

# Workarounds for connection
CONFIG_BT_AUTO_DATA_LEN_UPDATE=n
CONFIG_BT_BUF_ACL_RX_SIZE=251
CONFIG_BT_BUF_ACL_TX_SIZE=251
CONFIG_BT_CTLR_DATA_LENGTH_MAX=251
CONFIG_BT_USER_DATA_LEN_UPDATE=n
CONFIG_BT_PHY_UPDATE=n
CONFIG_BT_REMOTE_VERSION=n
CONFIG_BT_REMOTE_INFO=y
CONFIG_BT_CTLR=y
CONFIG_BT_CONN_PARAM_ANY=y
CONFIG_BT_CTLR_SDC_MAX_CONN_EVENT_LEN_DEFAULT=2000

#CONFIG_BT_LL_SW_SPLIT=n
#CONFIG_MPSL=n

# Enable the UART driver
CONFIG_USB_DEVICE_STACK=y
CONFIG_USB_DEVICE_MANUFACTURER="datacompboy"
CONFIG_USB_DEVICE_HID=y
CONFIG_USB_HID_DEVICE_COUNT=1
CONFIG_HID_INTERRUPT_EP_MPS=64
CONFIG_ENABLE_HID_INT_OUT_EP=y
CONFIG_USB_HID_POLL_INTERVAL_MS=1
CONFIG_USB_COMPOSITE_DEVICE=y

# C2
CONFIG_USB_DEVICE_PRODUCT="nRF KAT-VR Receiver"
CONFIG_USB_DEVICE_VID=0xC4F4
CONFIG_USB_DEVICE_PID=0x2F37
# Kat libraries support SN length up to 12 chars with 11 being used now.
CONFIG_USB_DEVICE_SN="TEMPLATE11c"

# Enable settings
CONFIG_NVS=y
CONFIG_FLASH=y
CONFIG_FLASH_MAP=y
CONFIG_SETTINGS=y
CONFIG_SETTINGS_NVS=y

# Application settings. xiao_ble board forces console & serial, so force-off them for release
CONFIG_APP_DEBUG=n
CONFIG_CONSOLE=n
CONFIG_SERIAL=n

# CONFIG_APP_KEEP_CONNECTIONS=n
# CONFIG_APP_DEBUG_BOOT_CONNECTIONS=n

CONFIG_APP_KAT_FREQ_PARAM=y
# CONFIG_APP_KAT_FREQ_133=y
# CONFIG_APP_KAT_FREQ_114=y
# CONFIG_APP_KAT_FREQ_100=y

CONFIG_APP_FEET_ROTATION=y
```

## prj_c2core.conf
```kconfig
# C2Core configuration override
CONFIG_USB_DEVICE_PRODUCT="nRF KAT-VR Receiver"
CONFIG_USB_DEVICE_VID=0xC4F4
CONFIG_USB_DEVICE_PID=0x3F37
```

## prj_c2penh.conf
```kconfig
# C2+Enhanced configuration override
CONFIG_USB_DEVICE_PRODUCT="nRF KAT-VR Receiver"
CONFIG_USB_DEVICE_VID=0xC4F4
CONFIG_USB_DEVICE_PID=0x3F12
```

## prj_debug.conf
```kconfig
# Enable debug build overlay to enable and adjust extra debug options
CONFIG_APP_DEBUG=y
CONFIG_CONSOLE=y
CONFIG_SERIAL=y

# Extra app logging & debug options
CONFIG_APP_PACKET_LOG=n
CONFIG_APP_ACCEPT_UNPAIRED_SENSORS=y

# Extra subsystems logging
#CONFIG_BT_A2DP_LOG_LEVEL_DBG=y
#CONFIG_BT_BAS_LOG_LEVEL_DBG=y
#CONFIG_BT_DF_LOG_LEVEL_DBG=y
#CONFIG_BT_HCI_DRIVER_LOG_LEVEL_DBG=y
#CONFIG_BT_LOG_LEVEL_DBG=y
#CONFIG_BT_RFCOMM_LOG_LEVEL_DBG=y
#CONFIG_BT_LOG_SNIFFER_INFO=y
#CONFIG_BT_ATT_LOG_LEVEL_DBG=y
#CONFIG_BT_GATT_LOG_LEVEL_DBG=y
#CONFIG_BT_CONN_LOG_LEVEL_DBG=y
#CONFIG_BT_HCI_CORE_LOG_LEVEL_DBG=y
#CONFIG_BT_L2CAP_LOG_LEVEL_DBG=y
```

## app.overlay
```dts
/*
For now, enable single USB-UART that act as a debug console.
*/

/ {
	chosen {
		zephyr,console = &usb_cdc_acm_uart;
	};
};
```

## src/main.c
```c
#include <stdlib.h>

#include <zephyr/kernel.h>
#include <zephyr/settings/settings.h>
#include <zephyr/sys/printk.h>

#include "kat_main.h"
#include "kat_ble.h"
#include "kat_usb.h"

/*
 * The global state.
 */

// Note: KatDeviceInfo[0] is unused, array idexed by eKatDevice
sKatDeviceInfo KatDeviceInfo[_KAT_MAX_DEVICE] = {{KAT_NONE}};

#ifdef CONFIG_APP_FEET_ROTATION
// Angle to turn data from left and right sensors before sending to PC.
float KatCorrectLeft = 0.0f;
float KatCorrectRight = 0.0f;
#endif

/*
 * Settings management.
 */

#ifdef CONFIG_SETTINGS

#define READ_SIMPLE_SETTING(NAME, VAR, DEFAULT) \
    if (settings_name_steq(key, NAME, &next) && !next) { \
        if (len != sizeof(VAR)) {                        \
            return -EINVAL;                              \
        }                                                \
        ret = read_cb(cb_arg, &VAR, sizeof(VAR));        \
        if (ret < 0) {                                   \
            VAR = DEFAULT;                               \
            return ret;                                  \
        }                                                \
        return 0;                                        \
    }

int kat_settings_set_cb(const char *key, size_t len, settings_read_cb read_cb, void *cb_arg)
{
    const char *next;
    int ret;

#ifdef CONFIG_APP_FEET_ROTATION
    READ_SIMPLE_SETTING("correctLeft", KatCorrectLeft, 0.0f);
    READ_SIMPLE_SETTING("correctRight", KatCorrectRight, 0.0f);
#endif
#ifdef CONFIG_APP_KAT_FREQ_PARAM
    READ_SIMPLE_SETTING("updateFreq", KatBleUpdateFrequency, (kat_ble_update_freq_param(), 86));
#endif
    READ_SIMPLE_SETTING("devCnt", NumKatBleDevices, 0);

    if (settings_name_steq(key, "serial", &next) && !next) {
        if (len != sizeof(katUsbSerial)) {
            return -EINVAL;
        }

        ret = read_cb(cb_arg, &katUsbSerial, sizeof(katUsbSerial));
        if (ret < 0) {
            strncpy(katUsbSerial, CONFIG_USB_DEVICE_SN, sizeof(katUsbSerial));
            katUsbSerial[sizeof(katUsbSerial)-1] = 0;
            return ret;
        }
        kat_usb_update_serial();
        return 0;
    }

    if (settings_name_steq(key, "dev", &next) && next && *next) {
        int dev = atoi(next);

        if (dev < 0 || dev > ARRAY_SIZE(KatBleDevices)) {
            return -ENOENT;
        }

        if (len != sizeof(KatBleDevices[dev].a)) {
            return -EINVAL;
        }

        KatBleDevices[dev].type = BT_ADDR_LE_PUBLIC; // Well, it's just zero, so noop.
        ret = read_cb(cb_arg, &KatBleDevices[dev].a, sizeof(KatBleDevices[dev].a));
        if (ret < 0) {
            memset(&KatBleDevices[dev].a, 0, sizeof(KatBleDevices[dev].a));
            return ret;
        }
        return 0;
    }

    return -ENOENT;
}

int kat_settings_export_cb(int(*export_func)(const char *name, const void *val, size_t val_len))
{
    int ret;

#ifdef CONFIG_APP_FEET_ROTATION
    ret = export_func("katrc/correctLeft", &KatCorrectLeft, sizeof(KatCorrectLeft));
    if (ret < 0) return ret;

    ret = export_func("katrc/correctRight", &KatCorrectRight, sizeof(KatCorrectRight));
    if (ret < 0) return ret;
#endif

#ifdef CONFIG_APP_KAT_FREQ_PARAM
    ret = export_func("katrc/updateFreq", &KatBleUpdateFrequency, sizeof(KatBleUpdateFrequency));
    if (ret < 0) return ret;
#endif

    ret = export_func("katrc/serial", &katUsbSerial, sizeof(katUsbSerial));
    if (ret < 0) return ret;

    ret = export_func("katrc/devCnt", &NumKatBleDevices, sizeof(NumKatBleDevices));
    if (ret < 0) return ret;

    char argstr[100] = "katrc/dev/";
    char * argsuffix = &argstr[strlen(argstr)]; // argsuffix now is the pointer beyond "/"
    for (int dev = 0; dev < NumKatBleDevices; ++dev) {
        sprintf(argsuffix, "%d", dev); // argstr now katrc/dev/N
        ret = export_func(argstr, &KatBleDevices[dev].a, sizeof(KatBleDevices[dev].a));
        if (ret < 0) return ret;
    }
    return 0;
}

SETTINGS_STATIC_HANDLER_DEFINE(
    katrc, "katrc", /*get=*/NULL, /*set=*/kat_settings_set_cb, /*commit=*/NULL, /*export=*/kat_settings_export_cb);

ASYNC_FUNC(kat_settings_async_save, K_MSEC(1000))
{
    int err = settings_save();
    if (err) {
        printk("Error saving settings: %d\n", err);
    }
}

void kat_settings_init()
{
    int err = settings_subsys_init();
    if (err)
    {
        printk("Error starting settings subsystem (err %d)\n", err);
    }
    err = settings_load();
    if (err)
    {
        printk("Error loading settings (err %d)\n", err);
    }
}

#else  // CONFIG_SETTINGS

bt_addr_le_t KatBleDevices[] = {
    // KAT_DIR
    // {.type = BT_ADDR_LE_PUBLIC, .a = {.val = {0x01, 0x74, 0xEB, 0x16, 0x4D, 0xAC}}}, // AC:4D:16:EB:74:01 - direction - unpaired
    {.type = BT_ADDR_LE_PUBLIC, .a = {.val = {0xCA, 0xF8, 0xF8, 0x66, 0x98, 0x60}}}, // 60:98:66:F8:F8:CA - direction - paired

    // KAT_LEFT
    // {.type = BT_ADDR_LE_PUBLIC, .a = {.val = {0x54, 0x46, 0xF2, 0x66, 0x98, 0x60}}}, // 60:98:66:F2:46:54 - unpaired
    {.type = BT_ADDR_LE_PUBLIC, .a={.val={0x0B, 0x9D, 0xF3, 0x66, 0x98, 0x60}}}, // 60:98:66:F3:9D:0B - paired left

    // KAT_RIGHT
    {.type = BT_ADDR_LE_PUBLIC, .a = {.val = {0x6A, 0x1C, 0xF2, 0x66, 0x98, 0x60}}}, // 60:98:66:F2:1C:6A - paired right
};
int NumKatBleDevices = ARRAY_SIZE(KatBleDevices);
BUILD_ASSERT(ARRAY_SIZE(KatBleDevices) < _KAT_MAX_DEVICE, "We can keep only that much different devices");

#define kat_settings_async_save do{}while(0)
#define kat_settings_init do{}while(0)

#endif  // CONFIG_SETTINGS

/*
 * Startup code.
 */

int main(void)
{
    if (IS_ENABLED(CONFIG_APP_DEBUG))
    {
        // Start USB subsystem first, as it also the one that provides console (in debug build).
        kat_usb_init();
        kat_settings_init();
    } else {
        // In release mode, enable USB after settings load to ensure device serial announced from the beginning
        kat_settings_init();
        kat_usb_init();
    }
    printk("*** nRF KAT Receiver ***\n");
    kat_ble_init();
    return 0;
}
```

## src/kat.h
```c
#ifndef __KAT_H__
#define __KAT_H__
#include <stdbool.h>
#include <stdint.h>

#include <zephyr/bluetooth/bluetooth.h>

typedef enum __packed
{
    KAT_NONE = 0,
    KAT_DIR,
    KAT_LEFT,
    KAT_RIGHT,
    _KAT_MAX_DEVICE
} tKatDevice;

// Internal representation

typedef struct
{
    tKatDevice deviceType;
} katConnectionInfo;

typedef struct
{
    // Status
    char firmwareVersion;
    char chargeStatus;
    short chargeLevel;
    bool freshStatus;
    // TODO: add timestamp
    bool freshData;
    int64_t connect_ts;
} tKatDeviceStatus;

typedef struct
{
    // Latest data
    char status1;
    char status2;
    short speed_x;
    short speed_y;
    char color;
} tKatFootDevice;

typedef struct
{
    // Latest data
    short axis[7];
    char button;
} tKatDirDevice;

typedef struct
{
    tKatDevice deviceType;
    tKatDeviceStatus deviceStatus;
    union
    {
        tKatFootDevice footData;
        tKatDirDevice dirData;
    };
} tKatDeviceInfo;

// Decoder from BT
void parseKatBtPacket(struct net_buf *req_buf, tKatDeviceInfo *katDevice);

// Encoder into USB
#define KAT_USB_PACKET_LEN 32
typedef uint8_t tKatUsbBuf[KAT_USB_PACKET_LEN];

void initKatUsb(void);
bool handle_kat_usb(uint8_t *buf, int size);
uint8_t *encodeKatUsbStatus(tKatDevice devId, tKatDeviceInfo *katDevice);
uint8_t *encodeKatUsbData(tKatDevice devId, tKatDeviceInfo *katDevice);

// TEMPORARY
extern char katUsbSerial[sizeof(CONFIG_USB_DEVICE_SN)];
void update_usb_serial(void);

extern bool usb_stream_enabled;
extern bt_addr_le_t katDevices[_KAT_MAX_DEVICE-1];
extern int numKatDevices;
extern tKatDeviceInfo devices[];
void reset_bt_filter(void);
void resume_connections(void);
void async_save_settings(void);
// TEMPORARY


#define ASYNC_FUNC(name, delay)                                 \
    void _do_async_##name(struct k_work *);                     \
    K_WORK_DEFINE(_worker_##name, _do_async_##name);            \
    void _timer_exp_##name(struct k_timer *timer)               \
    {                                                           \
        k_work_submit(&_worker_##name);                         \
    }                                                           \
    K_TIMER_DEFINE(_timer_##name, _timer_exp_##name, NULL);     \
    void name(void)                                             \
    {                                                           \
        k_timer_start(&_timer_##name, delay, K_NO_WAIT);        \
    }                                                           \
    void _do_async_##name(struct k_work *)


#endif // __KAT_H__
```

## src/kat_ble.c
```c
#include <stdlib.h>

#include <zephyr/kernel.h>
#include <zephyr/bluetooth/bluetooth.h>
#include <zephyr/bluetooth/conn.h>
#include <zephyr/bluetooth/l2cap.h>
#include <zephyr/drivers/uart.h>
#include <zephyr/usb/usb_device.h>
#include <zephyr/usb/usbd.h>
#include <zephyr/usb/class/usb_hid.h>
#include <zephyr/settings/settings.h>
#include <zephyr/sys/printk.h>

#include "kat_main.h"

#include "kat_ble.h"
#include "kat_usb.h"

/*
 * Bluetooth connections management.
 */
#ifdef CONFIG_APP_DEBUG
const char *const KatDeviceName[] = {"KAT_NONE", "KAT_DIR", "KAT_LEFT", "KAT_RIGHT", "KAT_BUG"};
BUILD_ASSERT(ARRAY_SIZE(KatDeviceName) == _KAT_MAX_DEVICE + 1, "Don't miss a thing!");
#endif

static eKatDevice KatBleConnectionDevice[CONFIG_BT_MAX_CONN] = {KAT_NONE};
static atomic_t NumKatBleConnections = ATOMIC_INIT(0);
static atomic_t KatBleBits = ATOMIC_INIT(0);
enum { bitBleActive, bitBleEnabled };

#ifdef CONFIG_SETTINGS
bt_addr_le_t KatBleDevices[_KAT_MAX_DEVICE-1] = {};
int NumKatBleDevices = 0;
#else
bt_addr_le_t KatBleDevices[] = {
    // KAT_DIR
    // {.type = BT_ADDR_LE_PUBLIC, .a = {.val = {0x01, 0x74, 0xEB, 0x16, 0x4D, 0xAC}}}, // AC:4D:16:EB:74:01 - direction - unpaired
    {.type = BT_ADDR_LE_PUBLIC, .a = {.val = {0xCA, 0xF8, 0xF8, 0x66, 0x98, 0x60}}}, // 60:98:66:F8:F8:CA - direction - paired

    // KAT_LEFT
    // {.type = BT_ADDR_LE_PUBLIC, .a = {.val = {0x54, 0x46, 0xF2, 0x66, 0x98, 0x60}}}, // 60:98:66:F2:46:54 - unpaired
    {.type = BT_ADDR_LE_PUBLIC, .a={.val={0x0B, 0x9D, 0xF3, 0x66, 0x98, 0x60}}}, // 60:98:66:F3:9D:0B - paired left

    // KAT_RIGHT
    {.type = BT_ADDR_LE_PUBLIC, .a = {.val = {0x6A, 0x1C, 0xF2, 0x66, 0x98, 0x60}}}, // 60:98:66:F2:1C:6A - paired right
};
int NumKatBleDevices = ARRAY_SIZE(KatBleDevices);
BUILD_ASSERT(ARRAY_SIZE(KatBleDevices) < _KAT_MAX_DEVICE, "We can keep only that much different devices");
#endif

#ifdef CONFIG_APP_DEBUG
//
// Track and print latest statistics for the received packets
//
#define LINEUP "\r\33[2K"
static int __stat[6]={0};
static int __stat_sec[6][6]={{0}};
static int64_t __last_sec = 0;
static void __kat_ble_track_stat(int dev, int pack, struct bt_conn* conn)
{
    if (dev) {
        __stat[(dev-1)*2+pack]++;

        int64_t now = k_uptime_get();
        if (now - __last_sec >= 1000) {
            // Use simple moving averaging by keeping snapshots of counters for N+1 intervals.
            for (int i=0; i<ARRAY_SIZE(__stat_sec)-1; ++i) {
                memcpy(&__stat_sec[i], &__stat_sec[i+1], sizeof(__stat_sec[i]));
            }
            memcpy(&__stat_sec[ARRAY_SIZE(__stat_sec)-1], &__stat, sizeof(__stat));
            __last_sec += 1000;

            #define SEC1s(i) (__stat_sec[5][i]-__stat_sec[4][i])
            #define SEC5s(i) ((__stat_sec[5][i]-__stat_sec[0][i])*1000/5)
            printk(LINEUP 
                        "Dd:%d Ds:%d Ld:%d Ls:%d Rd:%d Rs:%d  "
                        "D1d:%d D1s:%d L1d:%d L1s:%d R1d:%d R1s:%d  "
                        "D5d:%d D5s:%d L5d:%d L5s:%d R5d:%d R5s:%d  "
                    , __stat[0], __stat[1], __stat[2], __stat[3], __stat[4], __stat[5]
                    ,SEC1s(0),SEC1s(1),SEC1s(2),SEC1s(3),SEC1s(4),SEC1s(5)
                    ,SEC5s(0),SEC5s(1),SEC5s(2),SEC5s(3),SEC5s(4),SEC5s(5)
                    );

            // haaack. note : we check only once second pass, it could be not every dev is checked.
            if (false && SEC1s((dev-1)*2) < 30 && (now - KatDeviceInfo[dev].deviceStatus.connect_ts) > 5000) {
                printk("Sensor too slow, reconnect...\n");
                bt_conn_disconnect(conn, BT_HCI_ERR_UNACCEPT_CONN_PARAM);
            }
            #undef SEC1s
            #undef SEC5s
        }
    }
}
#else  /* CONFIG_APP_DEBUG */
#define __kat_ble_track_stat(...) do{}while(0)
#endif  /* CONFIG_APP_DEBUG */


static void kat_ble_do_disconnect(struct bt_conn *conn, void *data)
{
    ARG_UNUSED(data);
    bt_conn_disconnect(conn, BT_HCI_ERR_REMOTE_USER_TERM_CONN);
}

static void kat_ble_disconnect(void)
{
    bt_conn_create_auto_stop();
    bt_conn_foreach(BT_CONN_TYPE_LE, kat_ble_do_disconnect, NULL);
}

#ifdef CONFIG_APP_KEEP_CONNECTIONS
#define _disconnect_delay K_SECONDS(30)
#else
#define _disconnect_delay K_MSEC(100)
#endif
ASYNC_FUNC(kat_ble_async_disconnect, _disconnect_delay)
{
    // If we weren't re-enabled in meanwhile -- trigger disconnect.
    if (! atomic_test_bit(&KatBleBits, bitBleEnabled)) {
        atomic_clear_bit(&KatBleBits, bitBleActive);
        kat_ble_disconnect();
    }
}

static int kat_ble_setup_filter(void)
{
    int err = bt_le_filter_accept_list_clear();
    if (err)
    {
        printk("bt_le_filter_accept_list_clear error (%d / 0x%02d)", err, err);
        return err;
    }

    for (int i = 0; i < NumKatBleDevices; ++i)
    {
        if (! bt_addr_le_eq(&bt_addr_le_any, &KatBleDevices[i])) {
            char addr_str[BT_ADDR_LE_STR_LEN];
            bt_addr_le_to_str(&KatBleDevices[i], addr_str, sizeof(addr_str));
            #ifdef CONFIG_APP_DEBUG
            printk("Adding to accept list device %s: %s\n", KatDeviceName[i + 1], addr_str);
            #endif
            err = bt_le_filter_accept_list_add(&KatBleDevices[i]);
            if (err)
            {
                printk("bt_le_filter_accept_list_add error (%d / 0x%02d)", err, err);
                return err;
            }
        }
    }

    return 0;
}

BUILD_ASSERT(CONFIG_BT_CTLR_SDC_MAX_CONN_EVENT_LEN_DEFAULT <= 2000, "We need shortest possible connection intervals");
static const struct bt_conn_le_create_param btConnCreateParam = BT_CONN_LE_CREATE_PARAM_INIT(BT_CONN_LE_OPT_NONE, BT_GAP_SCAN_FAST_INTERVAL, 0x10);

// Note: btConnParam and btConnParamUpdate should differ by only for timeout argument.
#define KAT_BT_CONN_PARAM(timeout) BT_LE_CONN_PARAM_INIT(CONFIG_APP_KAT_CONN_INTERVAL, CONFIG_APP_KAT_CONN_INTERVAL, 5, timeout)
static struct bt_le_conn_param btConnParam = KAT_BT_CONN_PARAM(500);
static struct bt_le_conn_param btConnParamUpdate = KAT_BT_CONN_PARAM(100);

#ifdef CONFIG_APP_KAT_FREQ_PARAM
short KatBleUpdateFrequency = 86;
void kat_ble_update_freq_param()
{
    short interval = 800 / KatBleUpdateFrequency;
    interval = CLAMP(interval, 6, 16);
    KatBleUpdateFrequency = 800 / interval;
    btConnParam.interval_max = interval;
    btConnParam.interval_min = interval;
    btConnParamUpdate.interval_max = interval;
    btConnParamUpdate.interval_min = interval;
    printk("Set connection interval to %d (%d Hz update rate)\n", interval, KatBleUpdateFrequency);
}
#endif

ASYNC_FUNC(kat_ble_connect_next, K_MSEC(100))
{
    if (atomic_test_bit(&KatBleBits, bitBleActive) && atomic_get(&NumKatBleConnections) < NumKatBleDevices) {
        int err = bt_conn_le_create_auto(&btConnCreateParam, &btConnParam);
        if (err == -EALREADY) {

        }
        else if (err && err != -EALREADY)
        {
            printk("bt_conn_le_create_auto error (%d)", err);
        }
        else
        {
            printk("Fishing for known device in advertising stream...\n");
        }
    }
}

ASYNC_FUNC(kat_ble_update_devices, K_MSEC(100))
{
    kat_ble_disconnect();
    kat_ble_setup_filter();
    if (IS_ENABLED(CONFIG_APP_DEBUG_BOOT_CONNECTIONS)) {
        kat_ble_connect_next();
    }
}

static void kat_ble_connected_cb(struct bt_conn *conn, uint8_t conn_err)
{
    if (!conn_err)
    {
        atomic_inc(&NumKatBleConnections);
        int conn_num = bt_conn_index(conn);
        printk("Device connected (%p/%d)\n", conn, conn_num);

        if (KatBleConnectionDevice[conn_num] == KAT_NONE)
        {
            int i;
            for (i = 0; i < NumKatBleDevices; ++i)
            {
                struct bt_conn_info info;
                bt_conn_get_info(conn, &info);
                if (bt_addr_le_eq(info.le.dst, &KatBleDevices[i]))
                {
                    eKatDevice dev = (eKatDevice)i + 1; // Shift by 1 from katDevices array
                    KatBleConnectionDevice[conn_num] = dev;
                    KatDeviceInfo[dev].deviceType = dev;
                    #ifdef CONFIG_APP_DEBUG
                    printk("Connected device of type %s\n", KatDeviceName[dev]);
                    #endif
                    // Not really helpful for KAT Gateway, which waits for several seconds anyway.
                    // But for native input reading sake, get fresh update ASAP is useful.
                    if (KatDeviceInfo[dev].deviceStatus.firmwareVersion > 0)
                        KatDeviceInfo[dev].deviceStatus.freshStatus = true;
                    KatDeviceInfo[dev].deviceStatus.connect_ts = k_uptime_get();
                    kat_usb_try_send_update();

                    break;
                }
            }
            if (i == NumKatBleDevices)
            {
                printk("Unexpected device connected, disconnect!");
                bt_conn_disconnect(conn, BT_HCI_ERR_UNACCEPT_CONN_PARAM);
            }
        }
    }
    else
    {
        printk("Connect error (%p/%x)\n", conn, conn_err);
        bt_conn_unref(conn);
    }
    kat_ble_connect_next();
}

static void kat_ble_auto_exchange_complete_cb(struct bt_conn *conn, struct bt_conn_remote_info *remote)
{
    // Delay send connection change till end of other communication,
    // as any other communication may break update stream.
    int err = bt_conn_le_param_update(conn, &btConnParamUpdate);
    if (!err)
    {
        printk("Sent param update.\n");
    }
    else
    {
        printk("Error on bt_conn_le_param_update (%d/0x%02x)\n", err, err);
    }
    kat_ble_connect_next();
}

static void kat_ble_disconnected_cb(struct bt_conn *conn, uint8_t reason)
{
    atomic_dec(&NumKatBleConnections);
    printk("Device disconnected (%p/0x%02x)\n", conn, reason);
    int conn_num = bt_conn_index(conn);
    KatBleConnectionDevice[conn_num] = KAT_NONE;
    kat_ble_connect_next();
}

BT_CONN_CB_DEFINE(KatBleConnectionCallbacks) = {
    .connected = kat_ble_connected_cb,
    .disconnected = kat_ble_disconnected_cb,
    .remote_info_available = kat_ble_auto_exchange_complete_cb,
};

/*
  Hack to get ATT stream before ATT/GATT driver.
*/
static int kat_ble_att_recv_cb(struct bt_l2cap_chan *chan, struct net_buf *req_buf)
{
    int id = bt_conn_index(chan->conn);
    const eKatDevice dev = KatBleConnectionDevice[id];

#if CONFIG_APP_PACKET_LOG
    printk("Received packet for %p %8s [%d]", chan->conn, KatDeviceName[dev], req_buf->len);
    for (int i = 0; i < req_buf->len; ++i)
    {
        printk(" %02x", req_buf->data[i]);
    }
    printk("\n");
#endif

    kat_ble_handle_packet(req_buf, &KatDeviceInfo[dev]);
#if CONFIG_APP_PACKET_LOG
    if (req_buf->data[3] == 0 && req_buf->data[4] == 0)
    {
        printk("%s: charge_level=%d, charge_status=%d, firmware=%d\n",
               KatDeviceName[KatBleConnectionDevice[id]],
               KatDeviceInfo[dev].deviceStatus.chargeLevel,
               KatDeviceInfo[dev].deviceStatus.chargeStatus,
               KatDeviceInfo[dev].deviceStatus.firmwareVersion);
    }
#endif
    __kat_ble_track_stat(dev, (req_buf->data[3] == 0 && req_buf->data[4] == 0), chan->conn);

    kat_usb_try_send_update();
    return 0;
}

static int kat_ble_att_accept_cb(struct bt_conn *conn, struct bt_l2cap_chan **ch)
{
    static struct bt_l2cap_le_chan att_chan_pool[CONFIG_BT_MAX_CONN];
    static const struct bt_l2cap_chan_ops ops = {
        .recv = kat_ble_att_recv_cb,
    };
    int id = bt_conn_index(conn);
    struct bt_l2cap_le_chan *chan = &att_chan_pool[id];
    chan->chan.ops = &ops;
    *ch = &chan->chan;
    return 0;
}

//
// WARNING: Hack, relying on Zephyr's 3.4/3.6 internal implementation.
// 
// As sensors sends GATT update without GATT characteristics definitions announcements,
// we install our own fixed L2CAP channel 0x0004 handler, alphabetically named early so
// we are installed before zerphyr's own GATT handler if enabled.
//
// Tested on 3.4.99 only so far, but code is the same on 3.6.99.
//
#if (KERNEL_VERSION_NUMBER >= ZEPHYR_VERSION(3,4,0)) && (KERNEL_VERSION_NUMBER < ZEPHYR_VERSION(3,7,0))

#ifndef BT_L2CAP_CHANNEL_DEFINE
// Include l2cap_internal.h if you build in-tree; otherwise, let's just steal definitions from compatible (v2.5.2)
struct bt_l2cap_fixed_chan
{
    uint16_t cid;
    int (*accept)(struct bt_conn *conn, struct bt_l2cap_chan **chan);
    bt_l2cap_chan_destroy_t destroy;
};
#define BT_L2CAP_CHANNEL_DEFINE(_name, _cid, _accept, _destroy)   \
    const STRUCT_SECTION_ITERABLE(bt_l2cap_fixed_chan, _name) = { \
        .cid = _cid,                                              \
        .accept = _accept,                                        \
        .destroy = _destroy,                                      \
    }
#define BT_L2CAP_CID_ATT 0x0004
#endif

BT_L2CAP_CHANNEL_DEFINE(a_att_fixed_chan, BT_L2CAP_CID_ATT, kat_ble_att_accept_cb, NULL);
#else  /* KERNEL_VERSION_NUMBER */
#error The USB Serial Update validated only for 3.4.99 .. 3.6.99. Fix needed.
#endif  /* KERNEL_VERSION_NUMBER */


/*
 * Public KAT BLE subsystem oeprations
*/

void kat_ble_enable_connections(void)
{
    atomic_set_bit(&KatBleBits, bitBleEnabled);
    atomic_set_bit(&KatBleBits, bitBleActive);
    kat_ble_connect_next();
    // Stop disconnection timer if it was active
    // (note: that will run it's function, but due to set bitBleEnabled it'll be noop)
    k_timer_stop(&_timer_kat_ble_async_disconnect);
}

void kat_ble_disable_connections(void)
{
    atomic_clear_bit(&KatBleBits, bitBleEnabled);
    kat_ble_async_disconnect();
}

void kat_ble_get_localaddr(uint8_t* output, size_t bufsize)
{
    bt_addr_le_t addr;
    size_t count = 1;
    bt_id_get(&addr, &count); // get only the 1st
    memccpy(output, addr.a.val, sizeof(addr.a.val), bufsize);
}

void kat_ble_init(void)
{
    int err = bt_enable(NULL);
    if (err)
    {
        printk("Bluetooth init failed (err %d)\n", err);
        return;
    }
    printk("Bluetooth initialized\n");
    kat_ble_setup_filter();
    if (IS_ENABLED(CONFIG_APP_DEBUG_BOOT_CONNECTIONS)) {
        kat_ble_enable_connections();
    }
}
```

## src/kat_ble.h
```c
#ifndef __KAT_BLE_H__
#define __KAT_BLE_H__
#include <stdbool.h>
#include <stdint.h>

#include <zephyr/bluetooth/bluetooth.h>

#include "kat_main.h"

/*
 * BLE subsystem management API and settings.
 */

// Dynamic setting settings update frequency
#ifdef CONFIG_APP_KAT_FREQ_PARAM
extern short KatBleUpdateFrequency;
void kat_ble_update_freq_param();
#endif

// Number of paired bluetooth sensors
extern int NumKatBleDevices;

// Addresses list of paired bluetooth sensors
extern bt_addr_le_t KatBleDevices[_KAT_MAX_DEVICE-1];

void kat_ble_init(void);
void kat_ble_update_devices(void);
void kat_ble_enable_connections(void);
void kat_ble_disable_connections(void);
void kat_ble_get_localaddr(uint8_t* output, size_t bufsize);

/*
 * BLE subsystem internal part.
 */

// Bluetooth KAT sensors packet parser.
void kat_ble_handle_packet(struct net_buf *req_buf, sKatDeviceInfo *katDevice);



#endif // __KAT_BLE_H__
```

## src/kat_ble_pack.c
```c
/*
 * KAT sensors BT packet handler.
 *
 * Sensors send updates as GATT NOTIFICATION (0x1B) for handle 0x002E of 20 bytes length.
 *
 * Sensors sends following packets:
 *   Bytes 0-1: 0000 => status (sent every 500 packets)
 *                  Status data (6 bytes of data, rest is garbage):
 *                      Byte 2 => sensor type (aka 3==right leg, 2==left leg, 1==direction, 0==unpaired)
 *                      Byte 3 => charge status, two bits (bit 0 == charging, bit 1 == fully charged)
 *                      Byte 4+5 => Short, charge level (in 1/256th, so 25600 == 100%)
 *                      Byte 6 => (Current foot sensor firmware version, 5 for feet, 4 for direction)
 *              non-zero => data   (499 other packets).
 *                  Foot sensor data (byte 0 equals 1, byte 1 equals 0):
 *                      Byte 2 & 3: two statuses (height from the ground & something else)
 *                        Byte (1-5) may be (1 0 1 0 1) [when something happens]
 *                      Byte 14-15: Speed X
 *                      Byte 16-17: Speed Y
 *                      Byte 18: always 0
 *                      Byte 19: brightness under the sensor (?)
 *                  Direction sensor data:
 *                      Bytes 0..13: 7 shorts, accelerometer data
 *                              First 4: direction, last 3 -- rotational angles, currently always zero
 *                      Byte 18: 0x80 if button press, 0 otherwise
 *
 * Example packets, status:
 *  KAT_LEFT  [23] 1b 2e 00 00 00 00 02 00 5f 05 00 29 00 00 00 10 00 00 00 00 00 00 1c -- unpaired
 *  KAT_LEFT  [23] 1b 2e 00 00 00 02 01 00 64 05 00 29 00 00 00 b0 3d 00 00 00 00 00 77 -- paired
 *  KAT_RIGHT [23] 1b 2e 00 00 00 03 02 00 64 05 00 29 00 00 00 10 00 00 00 00 00 00 82 -- paired
 *  KAT_DIR   [23] 1b 2e 00 00 00 01 00 56 5e 04 3e 00 00 00 00 00 00 00 00 00 00 00 00
 *                 ^^^^^^^^ GATT prefix, notification for 0x002E
 *                          ^^ Type = status
 *                             ^^ always zero
 *                                ^^ Sensor type (2 left, 3 right, 1 dir, 0 unpaired)
 *                                   ^^ charge status bits
 *                                      ^^^^^ charge level
 *                                            ^^ firmware version
 *
 *  KAT_LEFT  [23] 1b 2e 00 01 00 00 8d 18 00 00 00 29 00 00 00 b0 3d 00 00 00 00 00 78 -- ground
 *  KAT_LEFT  [23] 1b 2e 00 01 08 4e 20 38 00 00 00 00 00 00 00 d0 00 00 00 00 00 00 1a -- air
 *  KAT_RIGHT [23] 1b 2e 00 01 00 00 92 18 00 00 00 29 00 00 00 10 00 00 00 00 00 00 83 -- ground
 *                 ^^^^^^^^ GATT prefix, notification for 0x002E
 *                          ^^ Packet type (1 == data update)
 *                                ^^^^^ some status bytes
 *  KAT_LEFT  [23] 1b 2e 00 01 00 00 73 9b 4f 05 00 84 01 00 00 00 00 51 fe 1f ff 00 7b
 *                                                                    ^^^^^ speed x
 *                                                                          ^^^^^ speed y
 *                                                                                   ^^ color under
 *
 *  KAT_DIR   [23] 1b 2e 00 7d f3 9f 00 8f 05 84 3e 00 00 00 00 00 00 00 00 00 00 00 00
 *  KAT_DIR   [23] 1b 2e 00 1f e4 59 00 e9 0a 91 38 00 00 00 00 00 00 00 00 00 00 80 00
 *                 ^^^^^^^^ GATT prefix, notification for 0x002E                  ^^ is button pressed
 *                          ^^^^^ Short 1     ^^^^^ short 4     ^^^^^ short 7
 *                                ^^^^^ Short 2     ^^^^^ short 5
 *                                      ^^^^^ Short 3     ^^^^^ short 6
 */

#include <zephyr/bluetooth/buf.h>

#include "kat_main.h"
#include "kat_ble.h"

#define GATT_NOTIFICATION 0x1B
#define KAT_CHAR_HANDLE 0x2E
#define KAT_BT_STATUS 0

typedef __PACKED_STRUCT
{
    __PACKED_UNION
    {
        short packetType; // 0 == status, non-zero == data
        __PACKED_STRUCT
        {
            short __zero;
            eKatDevice deviceType;
            char status;
            short chargeLevel; // network order (high, low)
            char firmwareVersion;
        }
        status;
        __PACKED_STRUCT
        {
            short __undef0;
            char status1;
            char status2;
            char __undef1[10];
            short speed_x; // network order (high, low)
            short speed_y; // network order (high, low)
            char __zero;
            char color;
        }
        footData;
        __PACKED_STRUCT
        {
            short axis[7];
            char __undef0[4];
            char button;
            char __undef1;
        }
        dirData;
    };
}
tKatBtData;

BUILD_ASSERT(sizeof(tKatBtData) == 20, "tKatBtData definition doesn't match expectation");
BUILD_ASSERT(offsetof(tKatBtData, footData.color) == 19, "footData structure doesn't match expectation");
BUILD_ASSERT(offsetof(tKatBtData, dirData.button) == 18, "dirData structure doesn't match expectation");

typedef __PACKED_STRUCT
{
    char gatt_comand;
    char char_id;
    char __zero;
    tKatBtData data;
}
tGattKatPacket;

BUILD_ASSERT(sizeof(tGattKatPacket) == 23, "tGattKatPacket definition doesn't match expectation");

void kat_ble_handle_packet(struct net_buf *req_buf, sKatDeviceInfo *katDevice)
{
    // Ignore not initialized sensors
    if (katDevice->deviceType == KAT_NONE)
        return;
    // Process only valid packets
    if (req_buf->len != sizeof(tGattKatPacket))
        return;
    tGattKatPacket *pack = (tGattKatPacket *)req_buf->data;
    if (pack->gatt_comand != GATT_NOTIFICATION)
        return;
    if (pack->char_id != KAT_CHAR_HANDLE || pack->__zero != 0)
        return;

    const tKatBtData *data = &pack->data;
    if (data->packetType == KAT_BT_STATUS)
    {
        if (!IS_ENABLED(CONFIG_APP_ACCEPT_UNPAIRED_SENSORS) && katDevice->deviceType != data->status.deviceType)
        {
            /// Sensor not paired, mark it broken
            printk("Sensor is not paired! Ignoring it");
            katDevice->deviceType = KAT_NONE;
            return;
        }
        katDevice->deviceStatus.chargeLevel = data->status.chargeLevel;
        katDevice->deviceStatus.chargeStatus = data->status.status;
        katDevice->deviceStatus.firmwareVersion = data->status.firmwareVersion;
        katDevice->deviceStatus.freshStatus = true;
    }
    else
    {
        switch (katDevice->deviceType)
        {
        case KAT_LEFT:
            [[fallthrough]];
        case KAT_RIGHT:
            /// refresh data
            katDevice->footData.color = data->footData.color;
            katDevice->footData.speed_x = data->footData.speed_x;
            katDevice->footData.speed_y = data->footData.speed_y;
            katDevice->footData.status1 = data->footData.status1;
            katDevice->footData.status2 = data->footData.status2;
            break;
        case KAT_DIR:
            BUILD_ASSERT(sizeof(katDevice->dirData.axis) == 14, "We copy whole sensor data batch (7 shorts)");
            BUILD_ASSERT(sizeof(katDevice->dirData.axis) == sizeof(data->dirData.axis), "We should copy matching arrays");
            memcpy(&katDevice->dirData.axis, &data->dirData.axis, sizeof(data->dirData.axis));
            katDevice->dirData.button = data->dirData.button;
            break;
        case _KAT_MAX_DEVICE:
            [[fallthrough]]; // Should not happen
        case KAT_NONE:       // Should not happen
            return;
        }
        // TODO: add timestamp
        katDevice->deviceStatus.freshData = true;
    }
}
```

## src/kat_bt_pack.c
```c
/*
 * KAT sensors BT packet handler.
 *
 * Sensors send updates as GATT NOTIFICATION (0x1B) for handle 0x002E of 20 bytes length.
 *
 * Sensors sends following packets:
 *   Bytes 0-1: 0000 => status (sent every 500 packets)
 *                  Status data (6 bytes of data, rest is garbage):
 *                      Byte 2 => sensor type (aka 3==right leg, 2==left leg, 1==direction, 0==unpaired)
 *                      Byte 3 => charge status, two bits (bit 0 == charging, bit 1 == fully charged)
 *                      Byte 4+5 => Short, charge level (in 1/256th, so 25600 == 100%)
 *                      Byte 6 => (Current foot sensor firmware version, 5 for feet, 4 for direction)
 *              non-zero => data   (499 other packets).
 *                  Foot sensor data (byte 0 equals 1, byte 1 equals 0):
 *                      Byte 2 & 3: two statuses (height from the ground & something else)
 *                        Byte (1-5) may be (1 0 1 0 1) [when something happens]
 *                      Byte 14-15: Speed X
 *                      Byte 16-17: Speed Y
 *                      Byte 18: always 0
 *                      Byte 19: brightness under the sensor (?)
 *                  Direction sensor data:
 *                      Bytes 0..13: 7 shorts, accelerometer data
 *                              First 4: direction, last 3 -- rotational angles, currently always zero
 *                      Byte 18: 0x80 if button press, 0 otherwise
 *
 * Example packets, status:
 *  KAT_LEFT  [23] 1b 2e 00 00 00 00 02 00 5f 05 00 29 00 00 00 10 00 00 00 00 00 00 1c -- unpaired
 *  KAT_LEFT  [23] 1b 2e 00 00 00 02 01 00 64 05 00 29 00 00 00 b0 3d 00 00 00 00 00 77 -- paired
 *  KAT_RIGHT [23] 1b 2e 00 00 00 03 02 00 64 05 00 29 00 00 00 10 00 00 00 00 00 00 82 -- paired
 *  KAT_DIR   [23] 1b 2e 00 00 00 01 00 56 5e 04 3e 00 00 00 00 00 00 00 00 00 00 00 00
 *                 ^^^^^^^^ GATT prefix, notification for 0x002E
 *                          ^^ Type = status
 *                             ^^ always zero
 *                                ^^ Sensor type (2 left, 3 right, 1 dir, 0 unpaired)
 *                                   ^^ charge status bits
 *                                      ^^^^^ charge level
 *                                            ^^ firmware version
 *
 *  KAT_LEFT  [23] 1b 2e 00 01 00 00 8d 18 00 00 00 29 00 00 00 b0 3d 00 00 00 00 00 78 -- ground
 *  KAT_LEFT  [23] 1b 2e 00 01 08 4e 20 38 00 00 00 00 00 00 00 d0 00 00 00 00 00 00 1a -- air
 *  KAT_RIGHT [23] 1b 2e 00 01 00 00 92 18 00 00 00 29 00 00 00 10 00 00 00 00 00 00 83 -- ground
 *                 ^^^^^^^^ GATT prefix, notification for 0x002E
 *                          ^^ Packet type (1 == data update)
 *                                ^^^^^ some status bytes
 *  KAT_LEFT  [23] 1b 2e 00 01 00 00 73 9b 4f 05 00 84 01 00 00 00 00 51 fe 1f ff 00 7b
 *                                                                    ^^^^^ speed x
 *                                                                          ^^^^^ speed y
 *                                                                                   ^^ color under
 *
 *  KAT_DIR   [23] 1b 2e 00 7d f3 9f 00 8f 05 84 3e 00 00 00 00 00 00 00 00 00 00 00 00
 *  KAT_DIR   [23] 1b 2e 00 1f e4 59 00 e9 0a 91 38 00 00 00 00 00 00 00 00 00 00 80 00
 *                 ^^^^^^^^ GATT prefix, notification for 0x002E                  ^^ is button pressed
 *                          ^^^^^ Short 1     ^^^^^ short 4     ^^^^^ short 7
 *                                ^^^^^ Short 2     ^^^^^ short 5
 *                                      ^^^^^ Short 3     ^^^^^ short 6
 */

#include <zephyr/bluetooth/buf.h>

#include "kat.h"

#define GATT_NOTIFICATION 0x1B
#define KAT_CHAR_HANDLE 0x2E
#define KAT_BT_STATUS 0

typedef __PACKED_STRUCT
{
    __PACKED_UNION
    {
        short packetType; // 0 == status, non-zero == data
        __PACKED_STRUCT
        {
            short __zero;
            tKatDevice deviceType;
            char status;
            short chargeLevel; // network order (high, low)
            char firmwareVersion;
        }
        status;
        __PACKED_STRUCT
        {
            short __undef0;
            char status1;
            char status2;
            char __undef1[10];
            short speed_x; // network order (high, low)
            short speed_y; // network order (high, low)
            char __zero;
            char color;
        }
        footData;
        __PACKED_STRUCT
        {
            short axis[7];
            char __undef0[4];
            char button;
            char __undef1;
        }
        dirData;
    };
}
tKatBtData;

BUILD_ASSERT(sizeof(tKatBtData) == 20, "tKatBtData definition doesn't match expectation");
BUILD_ASSERT(offsetof(tKatBtData, footData.color) == 19, "footData structure doesn't match expectation");
BUILD_ASSERT(offsetof(tKatBtData, dirData.button) == 18, "dirData structure doesn't match expectation");

typedef __PACKED_STRUCT
{
    char gatt_comand;
    char char_id;
    char __zero;
    tKatBtData data;
}
tGattKatPacket;

BUILD_ASSERT(sizeof(tGattKatPacket) == 23, "tGattKatPacket definition doesn't match expectation");

void parseKatBtPacket(struct net_buf *req_buf, tKatDeviceInfo *katDevice)
{
    // Ignore not initialized sensors
    if (katDevice->deviceType == KAT_NONE)
        return;
    // Process only valid packets
    if (req_buf->len != sizeof(tGattKatPacket))
        return;
    tGattKatPacket *pack = (tGattKatPacket *)req_buf->data;
    if (pack->gatt_comand != GATT_NOTIFICATION)
        return;
    if (pack->char_id != KAT_CHAR_HANDLE || pack->__zero != 0)
        return;

    const tKatBtData *data = &pack->data;
    if (data->packetType == KAT_BT_STATUS)
    {
        if (!IS_ENABLED(CONFIG_APP_ACCEPT_UNPAIRED_SENSORS) && katDevice->deviceType != data->status.deviceType)
        {
            /// Sensor not paired, mark it broken
            printk("Sensor is not paired! Ignoring it");
            katDevice->deviceType = KAT_NONE;
            return;
        }
        katDevice->deviceStatus.chargeLevel = data->status.chargeLevel;
        katDevice->deviceStatus.chargeStatus = data->status.status;
        katDevice->deviceStatus.firmwareVersion = data->status.firmwareVersion;
        katDevice->deviceStatus.freshStatus = true;
    }
    else
    {
        switch (katDevice->deviceType)
        {
        case KAT_LEFT:
            [[fallthrough]];
        case KAT_RIGHT:
            /// refresh data
            katDevice->footData.color = data->footData.color;
            katDevice->footData.speed_x = data->footData.speed_x;
            katDevice->footData.speed_y = data->footData.speed_y;
            katDevice->footData.status1 = data->footData.status1;
            katDevice->footData.status2 = data->footData.status2;
            break;
        case KAT_DIR:
            BUILD_ASSERT(sizeof(katDevice->dirData.axis) == 14, "We copy whole sensor data batch (7 shorts)");
            BUILD_ASSERT(sizeof(katDevice->dirData.axis) == sizeof(data->dirData.axis), "We should copy matching arrays");
            memcpy(&katDevice->dirData.axis, &data->dirData.axis, sizeof(data->dirData.axis));
            katDevice->dirData.button = data->dirData.button;
            break;
        case _KAT_MAX_DEVICE:
            [[fallthrough]]; // Should not happen
        case KAT_NONE:       // Should not happen
            return;
        }
        // TODO: add timestamp
        katDevice->deviceStatus.freshData = true;
    }
}
```

## src/kat_main.h
```c
#ifndef __KAT_MAIN_H__
#define __KAT_MAIN_H__
#include <stdbool.h>
#include <stdint.h>

/*
 * Internal state representation types.
 */

typedef enum __packed
{
    KAT_NONE = 0,
    KAT_DIR,
    KAT_LEFT,
    KAT_RIGHT,
    _KAT_MAX_DEVICE
} eKatDevice;

// Internal representation

typedef struct
{
    // Status
    uint8_t firmwareVersion;
    uint8_t chargeStatus;
    uint16_t chargeLevel;
    bool freshStatus;
    // TODO: add timestamp
    bool freshData;
    int64_t connect_ts;
} sKatDeviceStatus;

typedef struct
{
    // Latest data
    uint8_t status1;
    uint8_t status2;
    int16_t speed_x;
    int16_t speed_y;
    uint8_t color;
} sKatFootDevice;

typedef struct
{
    // Latest data
    uint16_t axis[7];
    uint8_t button;
} sKatDirDevice;

typedef struct
{
    eKatDevice deviceType;
    sKatDeviceStatus deviceStatus;
    union
    {
        sKatFootDevice footData;
        sKatDirDevice dirData;
    };
} sKatDeviceInfo;


/*
 * System state.
 */

extern sKatDeviceInfo KatDeviceInfo[];

#ifdef CONFIG_APP_FEET_ROTATION
// Angle to turn data from left and right sensors before sending to PC.
extern float KatCorrectLeft;
extern float KatCorrectRight;
#endif


/*
 * Settings saving export.
 */
void kat_settings_async_save(void);


/*
 * Macro helper to create function that will run with slight delay from worker thread.
 *
 * Usage:
 *    ASYNC_FUNC(myfunc, K_MSEC(100))
 *    {
 *       printk("myfunc is called");
 *    }
 * From any other code:
 *    myfunc();
 */
#define ASYNC_FUNC(name, delay)                                 \
    void _do_async_##name(struct k_work *);                     \
    K_WORK_DEFINE(_worker_##name, _do_async_##name);            \
    void _timer_exp_##name(struct k_timer *timer)               \
    {                                                           \
        k_work_submit(&_worker_##name);                         \
    }                                                           \
    K_TIMER_DEFINE(_timer_##name, _timer_exp_##name, NULL);     \
    void name(void)                                             \
    {                                                           \
        k_timer_start(&_timer_##name, delay, K_NO_WAIT);        \
    }                                                           \
    void _do_async_##name(struct k_work *)


// Enable configuration subsystem if any of the dynamic params enabled
#if defined(CONFIG_APP_FEET_ROTATION) || defined(CONFIG_APP_KAT_FREQ_PARAM)
#define __KAT_CONFIG_COMMANDS__
#endif

#endif // __KAT_MAIN_H__
```

## src/kat_usb.h
```c
#ifndef __KAT_USB_H__
#define __KAT_USB_H__
#include <stdbool.h>
#include <stdint.h>

#include "kat_main.h"

/*
 * USB subsystem management API and settings.
 */

int kat_usb_init(void);
bool kat_usb_try_send_update(void);

extern char katUsbSerial[sizeof(CONFIG_USB_DEVICE_SN)];
void kat_usb_update_serial(void);

/*
 * USB subsystem internal part.
 */

#define KAT_USB_PACKET_LEN 32
typedef uint8_t tKatUsbBuf[KAT_USB_PACKET_LEN];

void kat_usb_init_buffers(void);
bool kat_usb_handle_request(uint8_t *buf, int size);
uint8_t * kat_usb_get_update_packet(void);
void kat_usb_enable_stream(void);
void kat_usb_disable_stream(void);

#endif // __KAT_USB_H__
```
